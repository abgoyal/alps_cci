;winclear

&NR_CPUS=2

system.reset
SYSTEM.OPTION ENRESET ON
SYStem.Option ResBreak OFF
SYStem.Option WaitReset ON
SYStem.JtagClock 10.MHz
if &NR_CPUS==1
(
SYSTEM.CPU CortexA7MPCore
)
else
(
    SYStem.CPU CortexA7MPCore
)

if &NR_CPUS==1
(

    ;Setting Core debug register access
    SYStem.CONFIG CORENUMBER 1;
    SYSTEM.MULTICORE COREBASE 0x80070000
)
else
(

;Setting Core debug register access
	SYSTEM.CONFIG CORENUMBER 2;
	core.assign 1 2 
    SYSTEM.MULTICORE COREBASE 0x80070000 0x80072000;
)

SYStem.Up

; disable DABORT and PABORT breakpoint
tronchip.set dabort off
tronchip.set pabort off
tronchip.set undef off
tronchip.set irq off


; disable WDT
;d.s c:0x10000000 %le %long 0x22000024
d.s c:0x10007000 %le %long 0x22000064

; Init DDR
do MT6582_FPGA_DDR.cmm

; Linux kernel init start
&KernelPath="../../../../kernel/out"
&RamdiskImg="../../../../out/target/product/mt6582_fpga/android_rootfs.bin"
&PhyRamStart=0x80000000
&LimitRam=0x8000000
&KernelStart=&PhyRamStart+0x8000
&RamdiskStart=&PhyRamStart+0x04000000

print "loading Linux image..."
data.load.binary &KernelPath/arch/arm/boot/Image &KernelStart

print "loading ram disk"
Data.LOAD.Binary &RamdiskImg &RamdiskStart /noclear /nosymbol /quad

print "loading Linux kernel symbols..."
Data.LOAD.Elf &KernelPath/vmlinux /gnu /nocode

y.spath.reset
y.spath.srd ../../../../kernel/arch/arm/kernel
y.spath.srd ../../../../kernel/arch/arm/mm
y.spath.srd ../../../../kernel/arch/arm/include/asm
y.spath.srd ../../../../mediatek/platform/mt6582/kernel/core
y.spath.srd ../../../../mediatek/platform/mt6582/kernel/drivers

; Linux kernel init end

print "loading bootloader..."
data.load.elf mt6582_fpga_bl.axf /gnu /noclear

r.s r7 OS.FILE.SIZE(&RamdiskImg)
if &NR_CPUS==1
(
)
else
(
    core.select 1
    r.s pc 0x86000000
    core.select 0
    r.s pc 0x86000000
)

d.l
