;&lpddr2=0	; LPDDR
&lpddr2=1	; LPDDR2

D.S SD:0x10203000 %LE %LONG 0x0002A3AE  ;EMI_CONA    
D.S SD:0x10203060 %LE %LONG 0x00000500 ;EMI_CONM    

IF &lpddr2==0  ; LPDDR
(
)

IF &lpddr2==1  ; LPDDR2
(
D.S SD:0x100040fc %LE %LONG 0x03110000 ; ASYNC
D.S SD:0x100110fc %LE %LONG 0x03110000 ; ASYNC
D.S SD:0x10004048 %LE %LONG 0x0000110d 
D.S SD:0x10011048 %LE %LONG 0x0000110d 
D.S SD:0x100040d8 %LE %LONG 0x80500900 
D.S SD:0x100110d8 %LE %LONG 0x80500900 
D.S SD:0x100040f0 %LE %LONG 0x80000000 
D.S SD:0x100110f0 %LE %LONG 0x80000000 
D.S SD:0x100040e4 %LE %LONG 0x00000010 ; ASYNC
D.S SD:0x100110e4 %LE %LONG 0x00000010 ; ASYNC
D.S SD:0x1000408c %LE %LONG 0x00000001 
D.S SD:0x1001108c %LE %LONG 0x00000001 
D.S SD:0x10004090 %LE %LONG 0x00000000 
D.S SD:0x10011090 %LE %LONG 0x00000000 
D.S SD:0x10004094 %LE %LONG 0x80000000 
D.S SD:0x10011094 %LE %LONG 0x80000000 
D.S SD:0x100040dc %LE %LONG 0x83100100 
D.S SD:0x100110dc %LE %LONG 0x83100100 
D.S SD:0x100040e0 %LE %LONG 0x1b004004 
D.S SD:0x100110e0 %LE %LONG 0x1b004004 
D.S SD:0x10004124 %LE %LONG 0xaa0800aa 
D.S SD:0x10011124 %LE %LONG 0xaa0800aa 
D.S SD:0x10004018 %LE %LONG 0x10101010 ;RANK0 DQS INPUT DELAY CHAIN SETTING
D.S SD:0x10011018 %LE %LONG 0x10101010 ;RANK0 DQS INPUT DELAY CHAIN SETTING
D.S SD:0x1000401c %LE %LONG 0x10101010 ;RANK1 DQS INPUT DELAY CHAIN SETTING
D.S SD:0x1001101c %LE %LONG 0x10101010 ;RANK1 DQS INPUT DELAY CHAIN SETTING
D.S SD:0x100040f4 %LE %LONG 0x01000000 ;3PLL sync mode
D.S SD:0x100110f4 %LE %LONG 0x01000000 ;3PLL sync mode
D.S SD:0x10004168 %LE %LONG 0x00000010 ;MAXPENDCNT
D.S SD:0x10011168 %LE %LONG 0x00000010 ;MAXPENDCNT
D.S SD:0x100040d8 %LE %LONG 0x00700900 
D.S SD:0x100110d8 %LE %LONG 0x00700900 
D.S SD:0x10004004 %LE %LONG 0xf07487e1 
D.S SD:0x10011004 %LE %LONG 0xf07487e1 
D.S SD:0x1000407c %LE %LONG 0xc0063221 
D.S SD:0x1001107c %LE %LONG 0xc0063221 
D.S SD:0x10004028 %LE %LONG 0xf1200f01 
D.S SD:0x10011028 %LE %LONG 0xf1200f01 
D.S SD:0x100041e0 %LE %LONG 0x300003ff  ;performance
D.S SD:0x100111e0 %LE %LONG 0x300003ff  ;performance
D.S SD:0x10004158 %LE %LONG 0x00000000 
D.S SD:0x10011158 %LE %LONG 0x00000000 
D.S SD:0x10004400 %LE %LONG 0x00111100 
D.S SD:0x10011400 %LE %LONG 0x00111100 
D.S SD:0x10004404 %LE %LONG 0x00000002 
D.S SD:0x10011404 %LE %LONG 0x00000002 
D.S SD:0x10004408 %LE %LONG 0x00222222 
D.S SD:0x10011408 %LE %LONG 0x00222222 
D.S SD:0x1000440c %LE %LONG 0x33330000 
D.S SD:0x1001140c %LE %LONG 0x33330000 
D.S SD:0x10004410 %LE %LONG 0x33330000 
D.S SD:0x10011410 %LE %LONG 0x33330000 
;replaced by MEMPLL setting
;D.S SD:0x10004640 %LE %LONG 0x00003f03 //[13:8]="111111",default: 0x00000003
;D.S SD:0x10011640 %LE %LONG 0x00003f03 
D.S SD:0x100040b4 %LE %LONG 0xaa229922 //[15:12]DRVP/[11:8]DRVN, default: 0xaa22aa22
D.S SD:0x100110b4 %LE %LONG 0xaa229922 
D.S SD:0x100040b8 %LE %LONG 0x99229922 //[31:28]DQS DRVP/[27:24]DQS DRVN;[15:12]DQ DRVP/[11:8]DQ DRVN, default: 0xaa22aa22
D.S SD:0x100110b8 %LE %LONG 0x99229922 
D.S SD:0x100040bc %LE %LONG 0x99229922 //[31:28]CLK DRVP/[27:24]CLK DRVN;[15:12]CMD DRVP/[11:8]CMD DRVN;, default: 0xaa22aa22
D.S SD:0x100110bc %LE %LONG 0x99229922 
D.S SD:0x100040c0 %LE %LONG 0x00000000  //disable CMP;default: 0x00000000
D.S SD:0x100110c0 %LE %LONG 0x00000000 
D.S SD:0x10004644 %LE %LONG 0x00000000 //disable internal VREF; default: 0x00000000
D.S SD:0x10011644 %LE %LONG 0x00000000 
D.S SD:0x10004110 %LE %LONG 0x0b051111 ;[2:0] rankmode=1, [4]mrs2rk=1
D.S SD:0x10011110 %LE %LONG 0x0b051111 
D.S SD:0x100040e4 %LE %LONG 0x00000015  //CKEBYCTL
D.S SD:0x100110e4 %LE %LONG 0x00000015 
D.S SD:0x10004088 %LE %LONG 0x0000003f 
D.S SD:0x10011088 %LE %LONG 0x0000003f 
D.S SD:0x100041e4 %LE %LONG 0x00000001 
D.S SD:0x100111e4 %LE %LONG 0x00000001 
wait 1.ms ; wait 1 us
D.S SD:0x100041e4 %LE %LONG 0x00000000 
D.S SD:0x100111e4 %LE %LONG 0x00000000 
D.S SD:0x10004088 %LE %LONG 0x00ff000a 
D.S SD:0x10011088 %LE %LONG 0x00ff000a 
D.S SD:0x100041e4 %LE %LONG 0x00000001 
D.S SD:0x100111e4 %LE %LONG 0x00000001 
wait 1.ms ; wait 1 us
D.S SD:0x100041e4 %LE %LONG 0x00000000 
D.S SD:0x100111e4 %LE %LONG 0x00000000 
D.S SD:0x10004088 %LE %LONG 0x00330001 
D.S SD:0x10011088 %LE %LONG 0x00330001 
D.S SD:0x100041e4 %LE %LONG 0x00000001 
D.S SD:0x100111e4 %LE %LONG 0x00000001 
wait 1.ms ; wait 1 us
D.S SD:0x100041e4 %LE %LONG 0x00000000 
D.S SD:0x100111e4 %LE %LONG 0x00000000 
D.S SD:0x10004088 %LE %LONG 0x00060002 
D.S SD:0x10011088 %LE %LONG 0x00060002 
D.S SD:0x100041e4 %LE %LONG 0x00000001 
D.S SD:0x100111e4 %LE %LONG 0x00000001 
wait 1.ms ; wait 1 us
D.S SD:0x100041e4 %LE %LONG 0x00001100 
D.S SD:0x100111e4 %LE %LONG 0x00001100 
D.S SD:0x10004110 %LE %LONG 0x00111101 
D.S SD:0x10011110 %LE %LONG 0x00111101 
D.S SD:0x100040e4 %LE %LONG 0x00000011 
D.S SD:0x100110e4 %LE %LONG 0x00000011 
D.S SD:0x100041ec %LE %LONG 0x00000211 
D.S SD:0x100111ec %LE %LONG 0x00000211 
D.S SD:0x10004084 %LE %LONG 0x00000a56 
D.S SD:0x10011084 %LE %LONG 0x00000a56 
D.S SD:0x100041e4 %LE %LONG 0x00000000 
D.S SD:0x100111e4 %LE %LONG 0x00000000 
D.S SD:0x1000400c %LE %LONG 0x00000000 
D.S SD:0x1001100c %LE %LONG 0x00000000 
D.S SD:0x10004000 %LE %LONG 0x666844b4 
D.S SD:0x10011000 %LE %LONG 0x666844b4 
D.S SD:0x100041dc %LE %LONG 0x10672342 
D.S SD:0x100111dc %LE %LONG 0x10672342 
D.S SD:0x10004044 %LE %LONG 0x9f090401 
D.S SD:0x10011044 %LE %LONG 0x9f090401 
D.S SD:0x100041e8 %LE %LONG 0x01000e10 
D.S SD:0x100111e8 %LE %LONG 0x01000e10 
D.S SD:0x10004008 %LE %LONG 0x03406341 
D.S SD:0x10011008 %LE %LONG 0x03406341 
D.S SD:0x10004010 %LE %LONG 0x00000000 
D.S SD:0x10011010 %LE %LONG 0x00000000 
D.S SD:0x10004084 %LE %LONG 0x00000a56 
D.S SD:0x10011084 %LE %LONG 0x00000a56 
D.S SD:0x100040f8 %LE %LONG 0xedcb000f 
D.S SD:0x100110f8 %LE %LONG 0xedcb000f 
D.S SD:0x10004020 %LE %LONG 0x00000000 
D.S SD:0x10011020 %LE %LONG 0x00000000 
)
