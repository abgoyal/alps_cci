;&lpddr2=0	; LPDDR
;&lpddr2=1	; LPDDR2

D.S SD:0x10209000 %LE %LONG 0x00001133
D.S SD:0x10209000 %LE %LONG 0x00001137
wait 200.us
D.S SD:0x10209000 %LE %LONG 0x0000113F
D.S SD:0x10209218 %LE %LONG 0x00000003
wait 10.us
D.S SD:0x10209218 %LE %LONG 0x8009A000
D.S SD:0x10209200 %LE %LONG 0x80000001
D.S SD:0x10209234 %LE %LONG 0x00000001
D.S SD:0x10209220 %LE %LONG 0x800F8000
D.S SD:0x1020921C %LE %LONG 0xF0000001
wait 40.us
D.S SD:0x1020921C %LE %LONG 0xF8000001
D.S SD:0x10209268 %LE %LONG 0x00000003
wait 10.us
D.S SD:0x10209268 %LE %LONG 0x00000001
D.S SD:0x10209254 %LE %LONG 0x80100000
D.S SD:0x10209250 %LE %LONG 0x80000081
wait 40.us
D.S SD:0x10209238 %LE %LONG 0xF3003001
wait 40.us
D.S SD:0x10209238 %LE %LONG 0xFB003001
D.S SD:0x10209240 %LE %LONG 0xF0003701
wait 40.us
D.S SD:0x10209240 %LE %LONG 0xF8003701
D.S SD:0x10000100 %LE %LONG 0x0
D.S SD:0x10001008 %LE %LONG 0x0
D.S SD:0x10001000 %LE %LONG 0x00000004
D.S SD:0x10000140 %LE %LONG 0x02070305
D.S SD:0x10000144 %LE %LONG 0x04020101
D.S SD:0x10000148 %LE %LONG 0x05050505
D.S SD:0x1000014C %LE %LONG 0x80808001
D.S SD:0x10000150 %LE %LONG 0x01040607
D.S SD:0x10000158 %LE %LONG 0x01010101
D.S SD:0x1000015C %LE %LONG 0x01010101
D.S SD:0x10000164 %LE %LONG 0x00010501
D.S SD:0x10000104 %LE %LONG 0x0
D.S SD:0x1020900C %LE %LONG 0x0
D.S SD:0x10209004 %LE %LONG 0x0
D.S SD:0x10209008 %LE %LONG 0x0
D.S SD:0x10000154 %LE %LONG 0x000003FF
D.S SD:0x10000160 %LE %LONG 0x00000011



;mempll
D.S SD:0x10011640 %LE %LONG 0x0x20;
D.S SD:0x100115C0 %LE %LONG 0x0x0;
D.S SD:0x100115C4 %LE %LONG 0x0x0;
D.S SD:0x100115C8 %LE %LONG 0x0x1111ff11;
D.S SD:0x100115CC %LE %LONG 0x0x11111137;
D.S SD:0x10011600 %LE %LONG 0x0x0;
D.S SD:0x10011604 %LE %LONG 0x0xa4002000;
D.S SD:0x1001160C %LE %LONG 0x0x200;
D.S SD:0x10011608 %LE %LONG 0x0x28;
D.S SD:0x10011614 %LE %LONG 0x0x200;
D.S SD:0x10011610 %LE %LONG 0x0x28;
D.S SD:0x1001161C %LE %LONG 0x0x200;
D.S SD:0x10011618 %LE %LONG 0x0x28;
D.S SD:0x10011620 %LE %LONG 0x0x0;
D.S SD:0x10011624 %LE %LONG 0x0x98d1745d;
wait  2.us
D.S SD:0x10011604 %LE %LONG 0x0xa4006000;
wait  1.us
D.S SD:0x10011604 %LE %LONG 0x0xa400e000;
wait 1000.us
D.S SD:0x10011600 %LE %LONG 0x0x4;
wait  20.us
D.S SD:0x10011628 %LE %LONG 0x0x10000000;
wait  2.us
D.S SD:0x10011628 %LE %LONG 0x0x18000000;
D.S SD:0x10011620 %LE %LONG 0x0x810;
wait  2.us
D.S SD:0x10011600 %LE %LONG 0x0x2000004;
D.S SD:0x10011604 %LE %LONG 0x0xa500e000;
wait  23.us
D.S SD:0x1001160C %LE %LONG 0x0x40200;
D.S SD:0x10011614 %LE %LONG 0x0x40200;
D.S SD:0x1001161C %LE %LONG 0x0x40200;
D.S SD:0x10011640 %LE %LONG 0x0x30;
D.S SD:0x100115CC %LE %LONG 0x0x1010;
D.S SD:0x100115C8 %LE %LONG 0x0xf010;
D.S SD:0x100115C0 %LE %LONG 0x0x31b96;

