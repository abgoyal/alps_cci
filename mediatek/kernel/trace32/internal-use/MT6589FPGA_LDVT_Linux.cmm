;winclear

&NR_CPUS=2

system.reset
SYSTEM.OPTION ENRESET ON
SYStem.Option ResBreak OFF
SYStem.Option WaitReset ON
SYStem.JtagClock 10.MHz
if &NR_CPUS==1
(
SYSTEM.CPU CortexA7MPCore
)
else
(
    SYStem.CPU CortexA7MPCore
)

if &NR_CPUS==1
(

    ;Setting Core debug register access
    SYStem.CONFIG CORENUMBER 1;
    SYSTEM.MULTICORE COREBASE 0x80070000
)
else
(

;Setting Core debug register access
	SYSTEM.CONFIG CORENUMBER 2;
	core.assign 1 2 
    SYSTEM.MULTICORE COREBASE 0x80070000 0x80072000;
)

SYStem.Up

; disable DABORT and PABORT breakpoint
tronchip.set dabort off
tronchip.set pabort off
tronchip.set undef off
tronchip.set irq off

; set_hw_breakpoint_by_def
; setting attribute of breakpoints
;Break.Select Program OnChip
;Break.Select Hll OnChip
;Break.Select Spot OnChip
;Break.Select Read OnChip
;Break.Select Write OnChip

;Debugsys
;ETM.PORTSIZE 16
;ETM.READWRITEBREAK OFF
;ETM.DataTrace OFF
;ETM.CONTEXTID 32
;TRACE.MODE.FIFO
;CTS.MODE MEMORY
;ETM.BBC ON
;TRACE.AUTOINIT ON
;PERF.METHOD TRACE
;PERF.SORT RATIO
;PERF.MODE FUNCTION

;/* special settings for MTV-5 */
;data.set AHB:0xf0800058 %long 0x80f00e00   ; means 0xE0000000 ~0xF0000000 will use AXI Master1 
;data.set AHB:0xf080000c %long 0x400
;data.set AHB:0xf080000c %long 0x0

; disable WDT
d.s c:0x10000000 %le %long 0x22000024

; EMI setting
D.S SD:0x10203000 %LE %LONG 0x21102112; EMI_CONA
D.S SD:0x10203060 %LE %LONG 0x00000400; EMI_CONM
;D.S SD:0x10203000 %LE %LONG 0x0002A35A; EMI_CONA
;D.S SD:0x10203060 %LE %LONG 0x00000700; EMI_CONM
;D.S SD:0x10203140 %LE %LONG 0x10402488; EMI_ARBI
;D.S SD:0x10203100 %LE %LONG 0x4010580e; EMI_ARBA
;D.S SD:0x10203110 %LE %LONG 0xffff5803; EMI_ARBC
;D.S SD:0x10203118 %LE %LONG 0x0601580e; EMI_ARBD
;D.S SD:0x10203120 %LE %LONG 0x40405003; EMI_ARBE
;D.S SD:0x10203128 %LE %LONG 0x8080500f; EMI_ARBF
;D.S SD:0x10203130 %LE %LONG 0x8080500f; EMI_ARBG
;D.S SD:0x10203148 %LE %LONG 0x00464f2f; EMI_ARBJ
;D.S SD:0x10203150 %LE %LONG 0x00720038; EMI_ARBK
;D.S SD:0x10203158 %LE %LONG 0x0808084d; EMI_SLCT

;  DDRPHY setting
D.S SD:0x10011048 %LE %LONG 0x0000110d;
D.S SD:0x100110D8 %LE %LONG 0x00500900;
D.S SD:0x100110E4 %LE %LONG 0x00000001;
D.S SD:0x1001108c %LE %LONG 0x00000001;
D.S SD:0x10011090 %LE %LONG 0x00000000;
D.S SD:0x10011094 %LE %LONG 0x80000000;
D.S SD:0x100110DC %LE %LONG 0x83004004;
D.S SD:0x100110E0 %LE %LONG 0x01004004;
D.S SD:0x100110F0 %LE %LONG 0x00000000;
D.S SD:0x100110F4 %LE %LONG 0x01000000;
D.S SD:0x10011168 %LE %LONG 0x00000080;
D.S SD:0x100110D8 %LE %LONG 0x00700900;
D.S SD:0x10011004 %LE %LONG 0xF00487A2;
D.S SD:0x1001107C %LE %LONG 0xA00641c0;
D.S SD:0x10011028 %LE %LONG 0xF1200F01;
D.S SD:0x100111E0 %LE %LONG 0x3001ebff;
D.S SD:0x10011158 %LE %LONG 0x00000000;
D.S SD:0x100110e4 %LE %LONG 0x00000005;
wait 1.ms
D.S SD:0x10011088 %LE %LONG 0x0000003F;
;D.S SD:0x100111E4 %LE %LONG 0x00000001;
;D.S SD:0x100111E4 %LE %LONG 0x00000000;
wait 1.ms
D.S SD:0x10011088 %LE %LONG 0x00FF000A;
;D.S SD:0x100111E4 %LE %LONG 0x00000001;
;D.S SD:0x100111E4 %LE %LONG 0x00000000;
wait 1.ms
D.S SD:0x10011088 %LE %LONG 0x00320001;
;D.S SD:0x100111E4 %LE %LONG 0x00000001;
;D.S SD:0x100111E4 %LE %LONG 0x00000000;
wait 1.ms
D.S SD:0x10011088 %LE %LONG 0x00020002;
;D.S SD:0x100111E4 %LE %LONG 0x00000001;
;D.S SD:0x100111E4 %LE %LONG 0x00001100;
wait 1.ms
D.S SD:0x10011110 %LE %LONG 0x00111190;
D.S SD:0x100110E4 %LE %LONG 0x00000001;
D.S SD:0x10011084 %LE %LONG 0x00000a56;
D.S SD:0x1001100C %LE %LONG 0x00000000;
D.S SD:0x10011000 %LE %LONG 0x45D84408;
D.S SD:0x10011044 %LE %LONG 0xa8080401;
D.S SD:0x100111E8 %LE %LONG 0x00000510;
D.S SD:0x10011008 %LE %LONG 0x03406340;
D.S SD:0x10011010 %LE %LONG 0x00000000;
D.S SD:0x100110F8 %LE %LONG 0xEDCB000F;
D.S SD:0x100110FC %LE %LONG 0x27010000;

; DRAMC setting
D.S SD:0x10004048 %LE %LONG 0x0000110d;
D.S SD:0x100040D8 %LE %LONG 0x00500900;
D.S SD:0x100040E4 %LE %LONG 0x00000001;
D.S SD:0x1000408c %LE %LONG 0x00000001;
D.S SD:0x10004090 %LE %LONG 0x00000000;
D.S SD:0x10004094 %LE %LONG 0x80000000;
D.S SD:0x100040DC %LE %LONG 0x83004004;
D.S SD:0x100040E0 %LE %LONG 0x01004004;
D.S SD:0x100040F0 %LE %LONG 0x00000000;
D.S SD:0x100040F4 %LE %LONG 0x01000000;
D.S SD:0x10004168 %LE %LONG 0x00000080;
D.S SD:0x100040D8 %LE %LONG 0x00700900;
D.S SD:0x10004004 %LE %LONG 0xF00487A2;
D.S SD:0x1000407C %LE %LONG 0xA00641c0;
D.S SD:0x10004028 %LE %LONG 0xF1200F01;
D.S SD:0x100041E0 %LE %LONG 0x3001ebff;
D.S SD:0x10004158 %LE %LONG 0x00000000;
D.S SD:0x100040e4 %LE %LONG 0x00000005;
;wait 1.ms
D.S SD:0x10004088 %LE %LONG 0x0000003F;
D.S SD:0x100041E4 %LE %LONG 0x00000001;
D.S SD:0x100041E4 %LE %LONG 0x00000000;
D.S SD:0x100041E4 %LE %LONG 0x00000000;
D.S SD:0x100041E4 %LE %LONG 0x00000000;
D.S SD:0x100041E4 %LE %LONG 0x00000000;
D.S SD:0x100041E4 %LE %LONG 0x00000000;
D.S SD:0x100041E4 %LE %LONG 0x00000000;
D.S SD:0x100041E4 %LE %LONG 0x00000000;
D.S SD:0x100041E4 %LE %LONG 0x00000000;
D.S SD:0x100041E4 %LE %LONG 0x00000000;
D.S SD:0x100041E4 %LE %LONG 0x00000000;
;wait 1.ms
D.S SD:0x10004088 %LE %LONG 0x00FF000A;
D.S SD:0x100041E4 %LE %LONG 0x00000001;
D.S SD:0x100041E4 %LE %LONG 0x00000000;
D.S SD:0x100041E4 %LE %LONG 0x00000000;
D.S SD:0x100041E4 %LE %LONG 0x00000000;
D.S SD:0x100041E4 %LE %LONG 0x00000000;
D.S SD:0x100041E4 %LE %LONG 0x00000000;
D.S SD:0x100041E4 %LE %LONG 0x00000000;
D.S SD:0x100041E4 %LE %LONG 0x00000000;
D.S SD:0x100041E4 %LE %LONG 0x00000000;
D.S SD:0x100041E4 %LE %LONG 0x00000000;
D.S SD:0x100041E4 %LE %LONG 0x00000000;
;wait 1.ms
D.S SD:0x10004088 %LE %LONG 0x00320001;
D.S SD:0x100041E4 %LE %LONG 0x00000001;
D.S SD:0x100041E4 %LE %LONG 0x00000000;
D.S SD:0x100041E4 %LE %LONG 0x00000000;
D.S SD:0x100041E4 %LE %LONG 0x00000000;
D.S SD:0x100041E4 %LE %LONG 0x00000000;
D.S SD:0x100041E4 %LE %LONG 0x00000000;
D.S SD:0x100041E4 %LE %LONG 0x00000000;
D.S SD:0x100041E4 %LE %LONG 0x00000000;
D.S SD:0x100041E4 %LE %LONG 0x00000000;
D.S SD:0x100041E4 %LE %LONG 0x00000000;
D.S SD:0x100041E4 %LE %LONG 0x00000000;
;wait 1.ms
D.S SD:0x10004088 %LE %LONG 0x00020002;
D.S SD:0x100041E4 %LE %LONG 0x00000001;
D.S SD:0x100041E4 %LE %LONG 0x00001100;
D.S SD:0x100041E4 %LE %LONG 0x00000000;
D.S SD:0x100041E4 %LE %LONG 0x00000000;
D.S SD:0x100041E4 %LE %LONG 0x00000000;
D.S SD:0x100041E4 %LE %LONG 0x00000000;
D.S SD:0x100041E4 %LE %LONG 0x00000000;
D.S SD:0x100041E4 %LE %LONG 0x00000000;
D.S SD:0x100041E4 %LE %LONG 0x00000000;
D.S SD:0x100041E4 %LE %LONG 0x00000000;
D.S SD:0x100041E4 %LE %LONG 0x00000000;
;wait 1.ms
D.S SD:0x10004110 %LE %LONG 0x00111190;
D.S SD:0x100040E4 %LE %LONG 0x00000001;
D.S SD:0x10004084 %LE %LONG 0x00000a56;
D.S SD:0x1000400C %LE %LONG 0x00000000;
D.S SD:0x10004000 %LE %LONG 0x45D84408;
D.S SD:0x10004044 %LE %LONG 0xa8080401;
D.S SD:0x100041E8 %LE %LONG 0x00000510;
D.S SD:0x10004008 %LE %LONG 0x03406340;
D.S SD:0x10004010 %LE %LONG 0x00000000;
D.S SD:0x100040F8 %LE %LONG 0xEDCB000F;
D.S SD:0x100040FC %LE %LONG 0x27010000;


&KernelPath="../../../../kernel/out"

&RamdiskImg="../mt6589fpga_ca7_ldvt_ramdisk.img"
&PhyRamStart=0x81600000
;FIXED 1 rank, total 128M when Porting
&LimitRam=0x8000000
&KernelStart=&PhyRamStart+0x8000
&RamdiskStart=&PhyRamStart+0x01000000
&RamdiskSize=OS.FILE.SIZE(&RamdiskImg)
print "loading Linux image..."
data.load.binary &KernelPath/arch/arm/boot/Image &KernelStart

print "loading ram disk"
Data.LOAD.Binary &RamdiskImg &RamdiskStart /noclear /nosymbol /quad

print "loading bootloader..."
data.load.elf mt6589_fpga_bl.axf /gnu 

print "loading Linux kernel symbols..."
Data.LOAD.Elf &KernelPath/vmlinux /gnu /nocode

y.spath.reset
y.spath.srd ../../../../init
y.spath.srd ../../../../mm
y.spath.srd ../../../../kernel
y.spath.srd ../../../../kernel/irq
y.spath.srd ../../../../arch/arm/kernel
y.spath.srd ../../../../arch/arm/mm
y.spath.srd ../../../../arch/arm/lib
y.spath.srd ../../../../lib
y.spath.srd ../../../../drivers/serial
y.spath.srd ../../../../mediatek/platform/mt6589/kernel/

; Linux kernel init end

r.s r7 OS.FILE.SIZE(&RamdiskImg)
if &NR_CPUS==1
(
)
else
(
    core.select 1
    r.s pc 0x80100000
    core.select 0
    r.s pc 0x80100000
)

d.l
